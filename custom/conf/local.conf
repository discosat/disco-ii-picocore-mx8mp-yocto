## custom/conf/local.conf
```bitbake
MACHINE ??= 'fsimx8mp'
DISTRO ?= 'fus-imx-disco'
PACKAGE_CLASSES ?= 'package_rpm'
EXTRA_IMAGE_FEATURES ?= "debug-tweaks"
USER_CLASSES ?= "buildstats"
PATCHRESOLVE = "noop"
BB_DISKMON_DIRS ??= "\
    STOPTASKS,${TMPDIR},1G,100K \
    STOPTASKS,${DL_DIR},1G,100K \
    STOPTASKS,${SSTATE_DIR},1G,100K \
    STOPTASKS,/tmp,100M,100K \
    HALT,${TMPDIR},100M,1K \
    HALT,${DL_DIR},100M,1K \
    HALT,${SSTATE_DIR},100M,1K \
    HALT,/tmp,10M,1K"
PACKAGECONFIG:append:pn-qemu-system-native = " sdl"
CONF_VERSION = "2"

DL_DIR ?= "${BSPDIR}/downloads/"
ACCEPT_FSL_EULA = "1"

MIRRORS += " \
    git://source.codeaurora.org/external/imx/ git://github.com/nxp-imx/;protocol=https \n \
    https://source.codeaurora.org/external/imx/ https://github.com/nxp-imx/ \n \
    http://source.codeaurora.org/external/imx/ http://github.com/nxp-imx/ \n \
    gitsm://source.codeaurora.org/external/imx/ gitsm://github.com/nxp-imx/;protocol=https \n \
"

IMAGE_INSTALL:append = " python3"
IMAGE_INSTALL:append = " python3-pip"
IMAGE_INSTALL:append = " opencv"
IMAGE_INSTALL:append = " v4l-utils"
IMAGE_INSTALL:append = " tensorflow-lite tensorflow-lite-vx-delegate onnxruntime"
IMAGE_INSTALL:append = " python3-pillow"

IMAGE_INSTALL:append = " camera"
IMAGE_INSTALL:append = " pipeline"
IMAGE_INSTALL:append = " disco-scheduler"
IMAGE_INSTALL:append = " libcsp"
IMAGE_INSTALL:append = " csh"

# Switch to Debian packaging and include package-management in the image
PACKAGE_CLASSES = "package_deb"
EXTRA_IMAGE_FEATURES += "package-management"
```

## custom/layers/meta-disco-camera/conf/layer.conf
```bitbake
# We have a conf and classes directory, add to BBPATH
BBPATH .= ":${LAYERDIR}"

# We have recipes-* directories, add to BBFILES
BBFILES += "${LAYERDIR}/recipes*/*/*.bb \
            ${LAYERDIR}/recipes*/*/*.bbappend"

BBFILE_COLLECTIONS += "meta-disco-camera"
BBFILE_PATTERN_meta-disco-camera = "^${LAYERDIR}/"
BBFILE_PRIORITY_meta-disco-camera = "6"

LAYERDEPENDS_meta-disco-camera = "core"
LAYERSERIES_COMPAT_meta-disco-camera = "kirkstone"
```

## custom/layers/meta-disco-pipeline/conf/layer.conf
```bitbake
# We have a conf and classes directory, add to BBPATH
BBPATH .= ":${LAYERDIR}"

# We have recipes-* directories, add to BBFILES
BBFILES += "${LAYERDIR}/recipes*/*/*.bb \
            ${LAYERDIR}/recipes*/*/*.bbappend"

BBFILE_COLLECTIONS += "meta-disco"
BBFILE_PATTERN_meta-disco = "^${LAYERDIR}/"
BBFILE_PRIORITY_meta-disco = "6"

LAYERDEPENDS_meta-disco = "core"
LAYERSERIES_COMPAT_meta-disco = "kirkstone"
```

## custom/layers/meta-disco-scheduler/conf/layer.conf
```bitbake
# We have a conf and classes directory, add to BBPATH
BBPATH .= ":${LAYERDIR}"

# We have recipes-* directories, add to BBFILES
BBFILES += "${LAYERDIR}/*.bb \
            ${LAYERDIR}/*.bbappend"

BBFILE_COLLECTIONS += "meta-disco-scheduler"
BBFILE_PATTERN_meta-disco-scheduler = "^${LAYERDIR}/"
BBFILE_PRIORITY_meta-disco-scheduler = "5"

LAYERDEPENDS_meta-disco-scheduler = "core"
LAYERSERIES_COMPAT_meta-disco-scheduler = "kirkstone"
```

## custom/layers/meta-disco-upload/conf/layer.conf
```bitbake
# We have a conf and classes directory, add to BBPATH
BBPATH .= ":${LAYERDIR}"

# We have recipes-* directories, add to BBFILES
BBFILES += "${LAYERDIR}/recipes*/*/*.bb \
            ${LAYERDIR}/recipes*/*/*.bbappend"

BBFILE_COLLECTIONS += "meta-disco-upload"
BBFILE_PATTERN_meta-disco-upload = "^${LAYERDIR}/"
BBFILE_PRIORITY_meta-disco-upload = "5"

LAYERDEPENDS_meta-disco-upload = "core"
LAYERSERIES_COMPAT_meta-disco-upload = "kirkstone"
```

## custom/layers/meta-fus/conf/distro/fus-imx-disco.conf
```bitbake
include conf/distro/include/fsl-imx-base.inc
include conf/distro/include/fsl-imx-preferred-env.inc
include conf/distro/include/fus-common.inc

DISTRO = "fus-imx-disco"

DISTRO_FEATURES:remove = "directfb x11 "
DISTRO_FEATURES:append = " pam systemd"
```

## custom/layers/meta-fus/conf/distro/fus-imx-xwayland.conf
```bitbake
# i.MX DISTRO for Wayland with X11

# If we just set our preferred providers for kernel and u-boot in the
# machine files, they are overwritten by the NXP distro files later.
# So we define our own distros, similar to NXP, include NXP's settings
# first (in meta-fsl-bsp-release/imx/meta-sdk/conf/distro/include) and
# then include our settings later (in meta-fus/conf/distro/include),
# where we can override any NXP settings we need.

include conf/distro/fsl-imx-xwayland.conf
include conf/distro/include/fus-common.inc

# Distro name
DISTRO = "fus-imx-xwayland"
```

## custom/layers/meta-fus/conf/distro/include/fus-common.inc
```bitbake
# Common settings for all F&S boards

MKUBIFS_ARGS ??= "-m 2048 -e 126976 -c 2048"

# Remove image_types_fsl because there is a awk command which search after a
# point(.) in the devicetrees. But we have 2 points in the devicetree
# picocom1.2.dtb so the awk command find the first point, so the new name is
# picocom1 instead of picocom1.2. And thats why you get an error at compile
# time. Thats why we copy the image_types_fsl and rename it as image_types_fus
# and changed the line in the original file from
# "DTS_BASE_NAME=`basename ${DTS_FILE} | awk -F "." '{print $1}'`" to
# "DTS_BASE_NAME=`basename ${DTS_FILE} | awk -F ".dtb" '{print $1}'`"
# The Original file will be find in sources/meta-fsl-arm/classes/
# image_types_fsl.bbclass
IMAGE_CLASSES:remove = "image_types_fsl"
IMAGE_CLASSES += "image_types_fus"

# need hosttools crc32 for U-Boot addfsheader.sh
HOSTTOOLS_NONFATAL:append:mx8 = " crc32"

CORE_IMAGE_EXTRA_INSTALL:append = " fs-startscript "

# Remove Kernel Image from rootfs
RRECOMMENDS:${KERNEL_PACKAGE_NAME}-base = ""

# This is necessary because there will be some debian packages created and
# these packages must be lower case. Basically we set CONFIG_LOCALVERSION to
# "-F+S". This appends the string "-F+S". Due to the string is upper case we
# need to set variable to convert it to lower case.
KERNEL_MODULE_PACKAGE_SUFFIX = "${@legitimize_package_name(d.getVar('KERNEL_VERSION'))}"

INHERIT:append ?= " image-buildinfo"
```

## custom/layers/meta-fus/conf/layer.conf
```bitbake
# We have a conf and classes directory, add to BBPATH
BBPATH .= ":${LAYERDIR}"

# We have recipes-* directories, add to BBFILES
BBFILES += "${LAYERDIR}/recipes-*/*/*.bb \
            ${LAYERDIR}/recipes-*/*/*.bbappend"

BBFILE_COLLECTIONS += "fus fsvybrid"
BBFILE_PATTERN_fus = "^${LAYERDIR}/"
BBFILE_PRIORITY_fus = "9"
LAYERVERSION_fus = "1"
LAYERSERIES_COMPAT_fus = "kirkstone"

BBFILE_PATTERN_fsvybrid = "^${LAYERDIR}/"
BBFILE_PRIORITY_fsvybrid = "5"
LAYERVERSION_fsvybrid = "1"
LAYERSERIES_COMPAT_fsvybrid = "kirkstone"
```

## custom/layers/meta-fus/conf/machine/fsimx8mp.conf
```bitbake
#@TYPE: Machine
#@NAME: fsimx8mp
#@SOC: i.MX8MP
#@DESCRIPTION: Machine configuration for F&S boards with i.MX8M Plus
#@MAINTAINER: Anatol Derksen <derksen@fs-net.de>

MACHINEOVERRIDES =. "mx8:mx8m:mx8mp:"

require conf/machine/include/imx-base.inc
require conf/machine/include/fus-base.inc
require conf/machine/include/arm/armv8a/tune-cortexa53.inc

#Boot
PREFERRED_PROVIDER_virtual/bootloader:mx8mp-nxp-bsp = "u-boot-fus"
PREFERRED_PROVIDER_u-boot:mx8mp-nxp-bsp = "u-boot-fus"
UBOOT_MACHINE="fsimx8mp_defconfig"
UBOOT_SUFFIX:mx8mp-nxp-bsp = "fs"
UBOOT_BINARY:mx8mp-nxp-bsp = "uboot.${UBOOT_SUFFIX}"

#Kernel
KERNEL_IMAGETYPE = "Image"
KERNEL_DEVICETREE  = "F+S/picocoremx8mp.dtb"

#RootFS
IMAGE_FSTYPES = "ext4 wic.gz"

WKS_FILE_DEPENDS:remove:mx8mp-nxp-bsp = "imx-boot"
SOC_DEFAULT_WKS_FILE:mx8mp-nxp-bsp= "fus-no-uboot-bootpart.wks.in"

# Sets the login console.
# You may  specify a login here with e.g
# SERIAL_CONSOLE = "115200;ttymxc1"
# but this will also always open a login at the linux debug console
# as it is systemd default.
SERIAL_CONSOLES = "FUS_LOGIN_CONSOLE"
```

## custom/layers/meta-fus/conf/machine/include/fus-base.inc
```bitbake
# Common settings for all F&S boards

UBOOT_ENTRYPOINT:mx6-generic-bsp    = "0x10800000"
UBOOT_ENTRYPOINT:mx6sx-generic-bsp  = "0x80800000"
UBOOT_ENTRYPOINT:mx6ul-generic-bsp  = "0x80800000"
UBOOT_ENTRYPOINT:mx7ulp-generic-bsp = "0x60008000"

UBOOT_ENTRYPOINT:mx8mm-generic-bsp  = "0x40008000"
UBOOT_ENTRYPOINT:mx8mn-generic-bsp  = "0x40008000"
UBOOT_ENTRYPOINT:mx8mp-generic-bsp  = "0x40008000"

PREFERRED_PROVIDER_virtual/kernel:mx6-nxp-bsp    ??= "linux-fus"
PREFERRED_PROVIDER_virtual/kernel:mx6sx-nxp-bsp  ??= "linux-fus"
PREFERRED_PROVIDER_virtual/kernel:mx6ul-nxp-bsp  ??= "linux-fus"
PREFERRED_PROVIDER_virtual/kernel:mx7ulp-nxp-bsp ??= "linux-fus"

PREFERRED_PROVIDER_virtual/kernel:mx8mm-nxp-bsp ??= "linux-fus"
PREFERRED_PROVIDER_virtual/kernel:mx8mn-nxp-bsp ??= "linux-fus"
PREFERRED_PROVIDER_virtual/kernel:mx8mp-nxp-bsp ??= "linux-fus"

PREFERRED_PROVIDER_u-boot = "u-boot-fus"
PREFERRED_PROVIDER_virtual/bootloader:mx6-nxp-bsp    ??= "u-boot-fus"
PREFERRED_PROVIDER_virtual/bootloader:mx6sx-nxp-bsp  ??= "u-boot-fus"
PREFERRED_PROVIDER_virtual/bootloader:mx6ul-nxp-bsp  ??= "u-boot-fus"
PREFERRED_PROVIDER_virtual/bootloader:mx7ulp-nxp-bsp ??= "u-boot-fus"

PREFERRED_PROVIDER_virtual/bootloader:mx8mm-nxp-bsp  ??= "u-boot-fus"
PREFERRED_PROVIDER_virtual/bootloader:mx8mn-nxp-bsp  ??= "u-boot-fus"
PREFERRED_PROVIDER_virtual/bootloader:mx8mp-nxp-bsp  ??= "u-boot-fus"
```

## custom/layers/meta-si/conf/layer.conf
```bitbake
# We have a conf and classes directory, add to BBPATH
BBPATH .= ":${LAYERDIR}"

# We have recipes-* directories, add to BBFILES
BBFILES += "${LAYERDIR}/recipes*/*/*.bb \
            ${LAYERDIR}/recipes*/*/*.bbappend"

BBFILE_COLLECTIONS += "meta-si"
BBFILE_PATTERN_meta-si = "^${LAYERDIR}/"
BBFILE_PRIORITY_meta-si = "5"

LAYERDEPENDS_meta-si = "core"
LAYERSERIES_COMPAT_meta-si = "kirkstone"
```
